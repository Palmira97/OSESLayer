## conf/layer.conf
```bitbake
# We have a conf and classes directory, add to BBPATH
BBPATH .= ":${LAYERDIR}"

# We have recipes-* directories, add to BBFILES
BBFILES += "${LAYERDIR}/recipes-*/*/*.bb \
            ${LAYERDIR}/recipes-*/*/*.bbappend"

BBFILE_COLLECTIONS += "OSESLayer"
BBFILE_PATTERN_OSESLayer = "^${LAYERDIR}/"
BBFILE_PRIORITY_OSESLayer = "6"

LAYERDEPENDS_OSESLayer = "core"
LAYERSERIES_COMPAT_OSESLayer = "dunfell"
```
